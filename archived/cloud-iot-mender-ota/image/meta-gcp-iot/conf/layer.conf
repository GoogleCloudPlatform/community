## archived/cloud-iot-mender-ota/image/meta-gcp-iot/conf/layer.conf
```bitbake
# We have a conf and classes directory, add to BBPATH
BBPATH .= ":${LAYERDIR}"

# We have recipes-* directories, add to BBFILES
BBFILES += "${LAYERDIR}/recipes-*/*/*.bb \
            ${LAYERDIR}/recipes-*/*/*.bbappend"

BBFILE_COLLECTIONS += "meta-gcp-iot"
BBFILE_PATTERN_meta-gcp-iot = "^${LAYERDIR}/"
BBFILE_PRIORITY_meta-gcp-iot = "7"

LAYERSERIES_COMPAT_meta-gcp-iot = "master sumo rocko"

LAYERDEPENDS_meta-gcp-iot = "iot-cloud"
```

## tutorials/Embedded-C-IoT-Getting-Started/example/main/Kconfig.projbuild
```kconfig
menu "Example Configuration"

config ESP_WIFI_SSID
    string "WiFi SSID"
    default "myssid"
    help
	SSID (network name) for the example to connect to.

config ESP_WIFI_PASSWORD
    string "WiFi Password"
    default "mypassword"
    help
	WiFi password (WPA or WPA2) for the example to use.

config OUTPUT_GPIO
    int "Output GPIO"
    default 27
    help
    This is the GPIO on which output will be set.

config BLINK_GPIO
    int "Blink GPIO number"
    range 0 34
    default 5
    help
        GPIO number (IOxx) to blink on and off.

        Some GPIOs are used for other purposes (flash connections, etc.) and cannot be used to blink.

        GPIOs 35-39 are input-only so cannot be used as outputs.

endmenu
```

## tutorials/embedded-c-getting-started/Kconfig
```kconfig
menu "Google IoT Core Configuration"

config GIOT_PROJECT_ID
    string "Google Cloud Project ID"
    default "project_id"
    help
        Google Cloud project ID

config GIOT_LOCATION
    string "Google Cloud location"
    default "us-central1-a"
    help
        Google Cloud region

config GIOT_REGISTRY_ID
    string "Google IoT Core Registry ID"
    default "registry_id"
    help
        Google IoT Core registry id

config GIOT_DEVICE_ID
    string "Google IoT Core Device ID"
    default "device_id"
    help
        Google IoT Core device id

config GIOT_DEBUG_OUTPUT
    bool "Enable debugging"
    help
        Select this option to enable debugging support

endmenu
```

## tutorials/embedded-c-getting-started/examples/main/Kconfig.projbuild
```kconfig
#/******************************************************************************
#* Copyright 2020 Google
#* Licensed under the Apache License, Version 2.0 (the "License");
#* you may not use this file except in compliance with the License.
#* You may obtain a copy of the License at
#*
#*    http://www.apache.org/licenses/LICENSE-2.0
#*
#* Unless required by applicable law or agreed to in writing, software
#* distributed under the License is distributed on an "AS IS" BASIS,
#* WITHOUT WARRANTIES OR CONDITIONS OF ANY KIND, either express or implied.
#* See the License for the specific language governing permissions and
#* limitations under the License.
#*****************************************************************************/
menu "Example Configuration"

config ESP_WIFI_SSID
    string "WiFi SSID"
    default "myssid"
    help
	SSID (network name) for the example to connect to.

config ESP_WIFI_PASSWORD
    string "WiFi Password"
    default "mypassword"
    help
	WiFi password (WPA or WPA2) for the example to use.

config OUTPUT_GPIO
    int "Output GPIO"
    default 27
    help
    This is the GPIO on which output will be set.

config BLINK_GPIO
    int "Blink GPIO number"
    range 0 34
    default 5
    help
    GPIO number (IOxx) to blink on and off.

    Some GPIOs are used for other purposes (flash connections, etc.) and cannot be used to blink.

    GPIOs 35-39 are input-only so cannot be used as outputs.
endmenu
```
